BO_ 42 Status: 1 ECU
  SG_ State : 8|8@1+ (1,0) [0|255] "" ECU
