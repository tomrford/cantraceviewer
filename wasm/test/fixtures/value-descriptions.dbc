VERSION "1.0"

NS_ :

BS_:

BU_: ECU DASH

BO_ 100 Example: 8 ECU
    SG_ State : 0|8@1+ (1,0) [0|255] "" DASH

CM_ BO_ 100 "Example message";
CM_ SG_ 100 State "State comment";

BA_DEF_ "DBName" STRING;
BA_DEF_ "BusType" STRING;
BA_DEF_ BO_ "FrameOwner" STRING;
BA_DEF_ SG_ "SigKind" ENUM "A", "B";

BA_DEF_DEF_ "DBName" "";
BA_DEF_DEF_ "BusType" "CAN";
BA_DEF_DEF_ "FrameOwner" "";
BA_DEF_DEF_ "SigKind" "A";

BA_ "DBName" "ExampleDb";
BA_ "FrameOwner" BO_ 100 "Body";
BA_ "SigKind" SG_ 100 State 1;

VAL_ 100 State 0 "Off" 1 "On";
